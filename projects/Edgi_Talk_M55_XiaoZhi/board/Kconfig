## projects/Edgi_Talk_M55_XiaoZhi/board/Kconfig
```kconfig
menu "Xiaozhi Configuration Options"

    config BSP_USING_XiaoZhi
        bool "Enable XiaoZhi"
        default n
        select PKG_USING_CJSON
        select PKG_USING_WEBCLIENT
        select PKG_USING_MBEDTLS
        if BSP_USING_XiaoZhi
            config PKG_LIB_OPUS
                bool "Enable OPUS"
                default y
            config RT_LWIP_USING_WEBSOCKET
                bool "Enable LWIP WebSocket"
                default y
            config LWIP_ALTCP
                int "Enable LWIP ALTCP"
                default 1
            config LWIP_ALTCP_TLS
                int "Enable LWIP ALTCP_TLS"
                default 1
            config LWIP_ALTCP_TLS_MBEDTLS
                int "Enable LWIP ALTCP_TLS_MBEDTLS"
                default 1
            config BSP_XIAOZHI_SOUND_DEVICE_NAME
                string "Sound device name"
                default "sound0"
            config BSP_XIAOZHI_MIC_DEVICE_NAME
                string "Mic device name"
                default "mic0"
        endif

endmenu

config BSP_XIAOZHI_USB_CONSOLE
    bool "Use USB Type-C CDC ACM for console"
    default y
    select BSP_USING_USB
    select RT_CHERRYUSB_DEVICE
    select RT_CHERRYUSB_DEVICE_CDC_ACM
    help
        Use the project USB CDC console with the device template set to None.
        Set RT_CONSOLE_DEVICE_NAME to "usb-acm0".

# Prefer the project console over the SDK throughput-test template on regeneration.
choice CHERRYUSB_DEVICE_TEMPLATE
    default RT_CHERRYUSB_DEVICE_TEMPLATE_NONE if BSP_XIAOZHI_USB_CONSOLE
endchoice
```
